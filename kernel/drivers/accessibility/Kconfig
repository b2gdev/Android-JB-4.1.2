## kernel/drivers/accessibility/Kconfig
```kconfig
menuconfig ACCESSIBILITY
	bool "Accessibility support"
	---help---
	  Accessibility handles all special kinds of hardware devices or
	  software adapters which help people with disabilities (e.g.
	  blindness) to use computers.

	  That includes braille devices, speech synthesis, keyboard
	  remapping, etc.

	  Say Y here to get to see options for accessibility.
	  This option alone does not add any kernel code.

	  If you say N, all options in this submenu will be skipped and disabled.

	  If unsure, say N.

if ACCESSIBILITY
config A11Y_BRAILLE_CONSOLE
	bool "Console on braille device"
	depends on VT
	depends on SERIAL_CORE_CONSOLE
	---help---
	  Enables console output on a braille device connected to a 8250
	  serial port. For now only the VisioBraille device is supported.

	  To actually enable it, you need to pass option
	  console=brl,ttyS0
	  to the kernel. Options are the same as for serial console.

	  If unsure, say N.

# {PS} BEGIN:
#
# Metec Flat 20 Braille Display
#
menu "Metec Flat 20 Braille Display"
	depends on MFD_CP430_CORE

config METEC_FLAT20_BRAILLE_DISPLAY
        tristate "Support for Metec Flat 20 Braille Display"
        default m
         ---help---
	  Provides support for Metec Flat 20 Braille Display. For this
	  driver to work, CP430 Multi-function device is required.

	  If unsure, say N.
endmenu
# {PS} END:

endif # ACCESSIBILITY
```

## kernel/drivers/mfd/cp430-core/Kconfig
```kconfig
# {PK} BEGIN:

#
# CP430 multifunction devices
#

menu "CP430 Multifunction Drivers"
	depends on HAS_IOMEM && SPI_OMAP24XX

config MFD_CP430_CORE
	tristate "Support for CP430 Multifunction Device"
	default m
	 ---help---
	  This is the core driver for CP430 multifunction device.
endmenu

# {PK} END:
```
